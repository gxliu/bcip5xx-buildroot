## configs/bcip5xx_defconfig
```kconfig
#
# Architecture
#
BR2_arm=y
BR2_ARCH="arm"
BR2_ENDIAN="LITTLE"
BR2_GCC_TARGET_ABI="aapcs-linux"
BR2_generic_arm=y
BR2_ARM_EABI=y

#
# Build options
#
BR2_STRIP_sstrip=y
BR2_OPTIMIZE_S=y

#
# Toolchain
#
BR2_TOOLCHAIN_BUILDROOT=y

#
# Kernel Header Options
#
BR2_KERNEL_HEADERS_3_5=y
BR2_DEFAULT_KERNEL_HEADERS="3.5.7"

#
# uClibc Options
#
BR2_UCLIBC_VERSION_0_9_33=y
BR2_UCLIBC_VERSION_STRING="0.9.33.2"
BR2_UCLIBC_CONFIG="toolchain/uClibc/uClibc-0.9.33.config"
BR2_UCLIBC_ARM_TYPE="GENERIC_ARM"

#
# Binutils Options
#
BR2_BINUTILS_VERSION_2_21_1=y
BR2_BINUTILS_VERSION="2.21.1"
BR2_BINUTILS_EXTRA_CONFIG_OPTIONS=""

#
# GCC Options
#
BR2_GCC_VERSION_4_6_X=y
BR2_GCC_SUPPORTS_FINEGRAINEDMTUNE=y
BR2_GCC_VERSION="4.6.3"
BR2_EXTRA_GCC_CONFIG_OPTIONS=""
BR2_GCC_SHARED_LIBGCC=y
BR2_GCC_ENABLE_TLS=y

BR2_LARGEFILE=y
BR2_INET_IPV6=y
BR2_TOOLCHAIN_HAS_THREADS=y
BR2_TOOLCHAIN_HAS_THREADS_DEBUG_IF_NEEDED=y
BR2_TOOLCHAIN_HAS_SHADOW_PASSWORDS=y
BR2_ENABLE_LOCALE_PURGE=y
BR2_ENABLE_LOCALE_WHITELIST="C"
BR2_GENERATE_LOCALE=""
BR2_NEEDS_GETTEXT=y
BR2_USE_MMU=y
BR2_PREFER_SOFT_FLOAT=y
BR2_SOFT_FLOAT=y
BR2_TARGET_OPTIMIZATION="-pipe"
BR2_TARGET_LDFLAGS=""

#
# Toolchain Options
#
BR2_TOOLCHAIN_BUILDROOT_LARGEFILE=y
BR2_TOOLCHAIN_BUILDROOT_INET_IPV6=y
BR2_PTHREADS_NATIVE=y

#
# System configuration
#
BR2_TARGET_GENERIC_HOSTNAME="bc-cam"
BR2_TARGET_GENERIC_ISSUE="Welcome to Bluecherry Camera"
BR2_ROOTFS_DEVICE_CREATION_DYNAMIC_MDEV=y

BR2_INIT_BUSYBOX=y

BR2_ROOTFS_SKELETON_DEFAULT=y
BR2_TARGET_GENERIC_GETTY_PORT="ttyS0"
BR2_TARGET_GENERIC_GETTY_BAUDRATE_38400=y
BR2_TARGET_GENERIC_GETTY_BAUDRATE="38400"
BR2_ROOTFS_POST_BUILD_SCRIPT="board/bcip5xx/post-build"

#
# Package Selection for the target
#
BR2_PACKAGE_BUSYBOX=y
BR2_BUSYBOX_VERSION_1_20_X=y
BR2_BUSYBOX_VERSION="1.20.2"
BR2_PACKAGE_BUSYBOX_CONFIG="package/busybox/busybox-1.20.x.config"

BR2_PACKAGE_DROPBEAR=y
BR2_PACKAGE_DROPBEAR_DISABLE_REVERSEDNS=y
BR2_PACKAGE_DROPBEAR_SMALL=y

BR2_PACKAGE_LIGHTTPD=y
BR2_PACKAGE_LIGHTTPD_OPENSSL=y
BR2_PACKAGE_LIGHTTPD_ZLIB=y
BR2_PACKAGE_LIGHTTPD_PCRE=y

#
# Host utilities
#
BR2_PACKAGE_HOST_UBOOT_TOOLS=y

#
# Filesystem images
#
BR2_TARGET_ROOTFS_TAR=y
BR2_TARGET_ROOTFS_TAR_GZIP=y
BR2_TARGET_ROOTFS_TAR_OPTIONS=""

#
# Bootloaders
#

#
# Kernel
#
```
